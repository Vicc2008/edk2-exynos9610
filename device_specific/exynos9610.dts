// SPDX-License-Identifier: GPL-2.0-only

/dts-v1/;

/ {
	// This is used by the bootloader to find the correct DTB
	model = "Samsung Galaxy A50"; // FIXME
	compatible = "samsung,armv8", "samsung,exynos9610"; // FIXME
	
	#address-cells = <2>;
	#size-cells = <2>;

	// The bootloader gets really sad if it cannot find those nodes
	chosen { };

	memory@0 {
		device_type = "memory";
		/* We expect the bootloader to fill in the reg */
		reg = <0x0 0x80000000 0x80000000>;
	};
};
